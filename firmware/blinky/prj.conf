## CMakeLists.txt
```
cmake_minimum_required(VERSION 3.20.0)
find_package(Zephyr REQUIRED HINTS $ENV{ZEPHYR_BASE})
project(nora_b106_blinky)
target_sources(app PRIVATE src/main.c)
```

## prj.conf
```kconfig
CONFIG_GPIO=y
CONFIG_CONSOLE=n
CONFIG_SERIAL=n
CONFIG_PRINTK=n
# NORA-B106 has no external low-frequency crystal on this carrier.
CONFIG_CLOCK_CONTROL_NRF_K32SRC_RC=y
CONFIG_CLOCK_CONTROL_NRF_K32SRC_500PPM=y
```

## app.overlay
```dts
#include <zephyr/dt-bindings/gpio/gpio.h>
/* Use the nRF5340 DK SoC/memory configuration; replace only its LED pin. */
&led0 {
    gpios = <&gpio0 20 GPIO_ACTIVE_HIGH>;
    label = "NORA breakout test LED";
};
```

## src/main.c
```c
#include <zephyr/kernel.h>
#include <zephyr/drivers/gpio.h>

static const struct gpio_dt_spec led = GPIO_DT_SPEC_GET(DT_ALIAS(led0), gpios);

int main(void)
{
    if (!gpio_is_ready_dt(&led) || gpio_pin_configure_dt(&led, GPIO_OUTPUT_INACTIVE)) {
        return -1;
    }
    for (;;) {
        gpio_pin_toggle_dt(&led);
        k_msleep(500);
    }
    return 0;
}
```
