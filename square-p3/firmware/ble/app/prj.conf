## CMakeLists.txt
```
cmake_minimum_required(VERSION 3.20.0)
find_package(Zephyr REQUIRED HINTS $ENV{ZEPHYR_BASE})
project(nora_dragon_ble)
target_sources(app PRIVATE src/main.c src/led_service.c)
```

## prj.conf
```kconfig
CONFIG_GPIO=y
CONFIG_BT=y
CONFIG_BT_PERIPHERAL=y
CONFIG_BT_MAX_CONN=1
CONFIG_BT_DEVICE_NAME="NORA Dragon"
CONFIG_BT_DEVICE_NAME_DYNAMIC=y
CONFIG_BT_DEVICE_NAME_MAX=24
CONFIG_IPC_SERVICE=y
CONFIG_MBOX=y
CONFIG_SOC_NRF53_CPUNET_ENABLE=y
CONFIG_CLOCK_CONTROL_NRF_K32SRC_RC_CALIBRATION=y
CONFIG_NRF53_SYNC_RTC=n
CONFIG_SHELL=y
CONFIG_SHELL_BACKEND_SERIAL=y
CONFIG_SHELL_PROMPT_UART="nora> "
CONFIG_SHELL_VT100_COLORS=n
CONFIG_SHELL_VT100_COMMANDS=n
CONFIG_SHELL_BACKEND_SERIAL_RX_RING_BUFFER_SIZE=256
CONFIG_MAIN_STACK_SIZE=2048
CONFIG_SYSTEM_WORKQUEUE_STACK_SIZE=2048
CONFIG_HEAP_MEM_POOL_SIZE=4096
CONFIG_COMMON_LIBC_MALLOC_ARENA_SIZE=8192
CONFIG_LOG=y
CONFIG_LOG_BACKEND_UART=n
CONFIG_LOG_BACKEND_RTT=n
CONFIG_ASSERT=y
```

## src/main.c
```c
#include <zephyr/kernel.h>
#include <errno.h>
#include <zephyr/bluetooth/bluetooth.h>
#include <zephyr/bluetooth/conn.h>
#include <zephyr/shell/shell.h>
#include <zephyr/shell/shell_string_conv.h>
#include <zephyr/sys/atomic.h>
#include <stdio.h>
#include <string.h>
#include <hal/nrf_ficr.h>
#include "led_service.h"
#if defined(CONFIG_MCUMGR_TRANSPORT_BT)
#include <zephyr/mgmt/mcumgr/transport/smp_bt.h>
#endif

#ifndef NORA_FIRMWARE_VERSION
#define NORA_FIRMWARE_VERSION "LED-v2"
#endif

static atomic_t advertising;
static atomic_t connected;
static atomic_t bluetooth_ready;
static struct k_work_delayable advertising_work;
static char device_name[24];

static int start_advertising(void)
{
    const struct bt_data data[] = {
        BT_DATA_BYTES(BT_DATA_FLAGS, BT_LE_AD_GENERAL | BT_LE_AD_NO_BREDR),
#if defined(CONFIG_MCUMGR_TRANSPORT_BT)
        BT_DATA_BYTES(BT_DATA_UUID128_ALL, SMP_BT_SVC_UUID_VAL),
#else
        BT_DATA(BT_DATA_NAME_COMPLETE, device_name, strlen(device_name)),
#endif
    };
#if defined(CONFIG_MCUMGR_TRANSPORT_BT)
    const struct bt_data scan_response[] = {
        BT_DATA(BT_DATA_NAME_COMPLETE, device_name, strlen(device_name)),
    };
#endif
    int err = bt_le_adv_start(BT_LE_ADV_PARAM(BT_LE_ADV_OPT_CONN | BT_LE_ADV_OPT_USE_IDENTITY,
        BT_GAP_ADV_FAST_INT_MIN_2, BT_GAP_ADV_FAST_INT_MAX_2, NULL),
        data, ARRAY_SIZE(data),
#if defined(CONFIG_MCUMGR_TRANSPORT_BT)
        scan_response, ARRAY_SIZE(scan_response));
#else
        NULL, 0);
#endif
    if (!err || err == -EALREADY) {
        atomic_set(&advertising, 1);
        printk("Advertising as %s; connect for LED control\n", device_name);
        return 0;
    }
    return err;
}

static void restart_advertising(struct k_work *work)
{
    ARG_UNUSED(work);
    if (atomic_get(&connected) || !atomic_get(&bluetooth_ready)) {
        return;
    }
    int err = start_advertising();
    if (err) {
        printk("Advertising restart pending (%d)\n", err);
        k_work_reschedule(&advertising_work, K_MSEC(500));
    }
}

static void on_connected(struct bt_conn *conn, uint8_t err)
{
    ARG_UNUSED(conn);
    atomic_set(&advertising, 0);
    if (err) {
        printk("Bluetooth connection failed (%u)\n", err);
        return;
    }
    atomic_set(&connected, 1);
    printk("Bluetooth connected; LED service ready\n");
}

static void on_disconnected(struct bt_conn *conn, uint8_t reason)
{
    ARG_UNUSED(conn);
    atomic_set(&connected, 0);
    printk("Bluetooth disconnected (%u)\n", reason);
}

static void on_recycled(void)
{
    /* A connection object is free again: it is now safe to advertise. */
    if (atomic_get(&bluetooth_ready)) {
        k_work_reschedule(&advertising_work, K_NO_WAIT);
    }
}

BT_CONN_CB_DEFINE(connection_callbacks) = {
    .connected = on_connected,
    .disconnected = on_disconnected,
    .recycled = on_recycled,
};

static int cmd_info(const struct shell *sh, size_t argc, char **argv)
{
    ARG_UNUSED(argc); ARG_UNUSED(argv);
    shell_print(sh, "NORA Dragon BLE v2; ID %08x-%08x", NRF_FICR->INFO.DEVICEID[0],
                NRF_FICR->INFO.DEVICEID[1]);
    shell_print(sh, "Firmware version: %s", NORA_FIRMWARE_VERSION);
    shell_print(sh, "Name: %s; advertising: %s", device_name,
                atomic_get(&advertising) ? "active" : "not active");
    shell_print(sh, "Connection: %s; LED service: 7b1e0001-8e2f-4f4a-9d6c-3a5b7c9d0100",
                atomic_get(&connected) ? "connected" : "disconnected");
    bt_addr_le_t addresses[CONFIG_BT_ID_MAX];
    size_t count = ARRAY_SIZE(addresses);
    bt_id_get(addresses, &count);
    if (count) {
        char text[BT_ADDR_LE_STR_LEN];
        bt_addr_le_to_str(&addresses[0], text, sizeof(text));
        shell_print(sh, "Bluetooth identity: %s", text);
    }
    return 0;
}

static int cmd_led(const struct shell *sh, size_t argc, char **argv)
{
    ARG_UNUSED(argc);
    int mode = !strcmp(argv[0], "on") ? LED_ON : !strcmp(argv[0], "off") ? LED_OFF : LED_BLINK;
    int err = led_set_mode(mode);
    if (err) {
        shell_error(sh, "LED unavailable (%d)", err);
        return err;
    }
    shell_print(sh, "LED %s", mode == LED_ON ? "on" : mode == LED_OFF ? "off" : "blinking");
    return 0;
}

static int cmd_state(const struct shell *sh, size_t argc, char **argv)
{
    ARG_UNUSED(argc); ARG_UNUSED(argv);
    struct led_state state = led_snapshot();
    shell_print(sh, "LED mode=%u lit=%u interval=%u ms", state.mode, state.lit, state.interval_ms);
    return 0;
}

static int cmd_interval(const struct shell *sh, size_t argc, char **argv)
{
    ARG_UNUSED(argc);
    int err = 0;
    unsigned long interval = shell_strtoul(argv[1], 10, &err);
    if (err || interval < LED_INTERVAL_MIN_MS || interval > LED_INTERVAL_MAX_MS) {
        shell_error(sh, "Interval must be 50..5000 ms");
        return -EINVAL;
    }
    err = led_set_interval((uint16_t)interval);
    if (err) {
        shell_error(sh, "LED unavailable (%d)", err);
        return err;
    }
    shell_print(sh, "LED interval=%lu ms", interval);
    return 0;
}

SHELL_CMD_REGISTER(info, NULL, "Show board ID and Bluetooth status", cmd_info);
SHELL_CMD_REGISTER(on, NULL, "Turn test LED on", cmd_led);
SHELL_CMD_REGISTER(off, NULL, "Turn test LED off", cmd_led);
SHELL_CMD_REGISTER(blink, NULL, "Blink test LED", cmd_led);
SHELL_CMD_REGISTER(state, NULL, "Read LED mode, output and interval", cmd_state);
SHELL_CMD_ARG_REGISTER(interval, NULL, "Set blink interval: interval 50..5000", cmd_interval, 2, 0);

int main(void)
{
    if (led_control_init()) {
        printk("ERROR: LED GPIO unavailable\n");
        return -1;
    }
    k_work_init_delayable(&advertising_work, restart_advertising);
    snprintf(device_name, sizeof(device_name), "NORA Dragon %04X",
             (unsigned int)(NRF_FICR->INFO.DEVICEID[0] & 0xffff));
    printk("NORA Dragon BLE: starting host and network controller\n");
    int err = bt_enable(NULL);
    if (err) {
        printk("ERROR: Bluetooth initialization failed (%d)\n", err);
        return err;
    }
    err = bt_set_name(device_name);
    if (err) {
        printk("ERROR: Bluetooth name failed (%d)\n", err);
        return err;
    }
    atomic_set(&bluetooth_ready, 1);
    err = start_advertising();
    if (err) {
        printk("ERROR: Advertising failed (%d)\n", err);
        k_work_reschedule(&advertising_work, K_MSEC(500));
    }
    printk("UART commands: info, on, off, blink, interval <ms>, state\n");
    return 0;
}
```

## src/led_service.c
```c
#include "led_service.h"

#include <errno.h>
#include <zephyr/kernel.h>
#include <zephyr/bluetooth/gatt.h>
#include <zephyr/drivers/gpio.h>
#include <zephyr/sys/byteorder.h>

/* Service ...0001; mode ...0002; interval ...0003; status ...0004. */
#define LED_UUID(number) BT_UUID_128_ENCODE(0x7b1e0000u + (number), 0x8e2f, 0x4f4a, 0x9d6c, 0x3a5b7c9d0100)
static const struct bt_uuid_128 service_uuid = BT_UUID_INIT_128(LED_UUID(1));
static const struct bt_uuid_128 mode_uuid = BT_UUID_INIT_128(LED_UUID(2));
static const struct bt_uuid_128 interval_uuid = BT_UUID_INIT_128(LED_UUID(3));
static const struct bt_uuid_128 state_uuid = BT_UUID_INIT_128(LED_UUID(4));

static const struct gpio_dt_spec led = GPIO_DT_SPEC_GET(DT_ALIAS(led0), gpios);
static struct k_work_delayable led_work;
static K_MUTEX_DEFINE(led_lock);
static struct led_state state = { .mode = LED_BLINK, .interval_ms = 500 };
static bool ready;

static int apply_output(uint8_t lit)
{
    int err = gpio_pin_set_dt(&led, lit);
    if (!err) {
        state.lit = lit;
    }
    return err;
}

static void update_led(struct k_work *work)
{
    ARG_UNUSED(work);
    k_mutex_lock(&led_lock, K_FOREVER);
    if (state.mode == LED_BLINK) {
        apply_output(!state.lit);
        k_work_reschedule(&led_work, K_MSEC(state.interval_ms));
    }
    k_mutex_unlock(&led_lock);
}

int led_control_init(void)
{
    if (!gpio_is_ready_dt(&led)) {
        return -ENODEV;
    }
    int err = gpio_pin_configure_dt(&led, GPIO_OUTPUT_INACTIVE);
    if (err) {
        return err;
    }
    k_mutex_lock(&led_lock, K_FOREVER);
    k_work_init_delayable(&led_work, update_led);
    ready = true;
    k_work_reschedule(&led_work, K_NO_WAIT);
    k_mutex_unlock(&led_lock);
    return 0;
}

int led_set_mode(uint8_t mode)
{
    if (mode > LED_BLINK) {
        return -EINVAL;
    }
    k_mutex_lock(&led_lock, K_FOREVER);
    int err = ready ? 0 : -EAGAIN;
    if (!err) {
        err = apply_output(mode != LED_OFF);
    }
    if (!err) {
        state.mode = mode;
        if (mode == LED_BLINK) {
            k_work_reschedule(&led_work, K_MSEC(state.interval_ms));
        } else {
            /* A callback already waiting on the mutex will see the new mode. */
            k_work_cancel_delayable(&led_work);
        }
    }
    k_mutex_unlock(&led_lock);
    return err;
}

int led_set_interval(uint16_t interval_ms)
{
    if (interval_ms < LED_INTERVAL_MIN_MS || interval_ms > LED_INTERVAL_MAX_MS) {
        return -EINVAL;
    }
    k_mutex_lock(&led_lock, K_FOREVER);
    if (!ready) {
        k_mutex_unlock(&led_lock);
        return -EAGAIN;
    }
    state.interval_ms = interval_ms;
    if (state.mode == LED_BLINK) {
        k_work_reschedule(&led_work, K_MSEC(interval_ms));
    }
    k_mutex_unlock(&led_lock);
    return 0;
}

struct led_state led_snapshot(void)
{
    k_mutex_lock(&led_lock, K_FOREVER);
    struct led_state snapshot = state;
    k_mutex_unlock(&led_lock);
    return snapshot;
}

static ssize_t read_mode(struct bt_conn *conn, const struct bt_gatt_attr *attr,
                         void *buf, uint16_t len, uint16_t offset)
{
    struct led_state snapshot = led_snapshot();
    return bt_gatt_attr_read(conn, attr, buf, len, offset, &snapshot.mode, 1);
}

static ssize_t read_interval(struct bt_conn *conn, const struct bt_gatt_attr *attr,
                             void *buf, uint16_t len, uint16_t offset)
{
    uint8_t value[2];
    sys_put_le16(led_snapshot().interval_ms, value);
    return bt_gatt_attr_read(conn, attr, buf, len, offset, value, sizeof(value));
}

static ssize_t read_state(struct bt_conn *conn, const struct bt_gatt_attr *attr,
                          void *buf, uint16_t len, uint16_t offset)
{
    struct led_state snapshot = led_snapshot();
    uint8_t value[4] = { snapshot.mode, snapshot.lit };
    sys_put_le16(snapshot.interval_ms, &value[2]);
    return bt_gatt_attr_read(conn, attr, buf, len, offset, value, sizeof(value));
}

static ssize_t write_mode(struct bt_conn *conn, const struct bt_gatt_attr *attr,
                          const void *buf, uint16_t len, uint16_t offset, uint8_t flags)
{
    ARG_UNUSED(conn); ARG_UNUSED(attr); ARG_UNUSED(flags);
    if (offset) {
        return BT_GATT_ERR(BT_ATT_ERR_INVALID_OFFSET);
    }
    if (len != 1) {
        return BT_GATT_ERR(BT_ATT_ERR_INVALID_ATTRIBUTE_LEN);
    }
    uint8_t mode = *(const uint8_t *)buf;
    if (mode > LED_BLINK) {
        return BT_GATT_ERR(BT_ATT_ERR_VALUE_NOT_ALLOWED);
    }
    if (led_set_mode(mode)) {
        return BT_GATT_ERR(BT_ATT_ERR_UNLIKELY);
    }
    printk("BLE LED mode=%u\n", mode);
    return len;
}

static ssize_t write_interval(struct bt_conn *conn, const struct bt_gatt_attr *attr,
                              const void *buf, uint16_t len, uint16_t offset, uint8_t flags)
{
    ARG_UNUSED(conn); ARG_UNUSED(attr); ARG_UNUSED(flags);
    if (offset) {
        return BT_GATT_ERR(BT_ATT_ERR_INVALID_OFFSET);
    }
    if (len != 2) {
        return BT_GATT_ERR(BT_ATT_ERR_INVALID_ATTRIBUTE_LEN);
    }
    uint16_t interval_ms = sys_get_le16(buf);
    if (interval_ms < LED_INTERVAL_MIN_MS || interval_ms > LED_INTERVAL_MAX_MS) {
        return BT_GATT_ERR(BT_ATT_ERR_VALUE_NOT_ALLOWED);
    }
    if (led_set_interval(interval_ms)) {
        return BT_GATT_ERR(BT_ATT_ERR_UNLIKELY);
    }
    printk("BLE LED interval=%u ms\n", interval_ms);
    return len;
}

BT_GATT_SERVICE_DEFINE(led_service,
    BT_GATT_PRIMARY_SERVICE(&service_uuid),
    BT_GATT_CHARACTERISTIC(&mode_uuid.uuid, BT_GATT_CHRC_READ | BT_GATT_CHRC_WRITE,
        BT_GATT_PERM_READ | BT_GATT_PERM_WRITE, read_mode, write_mode, NULL),
    BT_GATT_CUD("LED mode: 00 off, 01 on, 02 blink", BT_GATT_PERM_READ),
    BT_GATT_CHARACTERISTIC(&interval_uuid.uuid, BT_GATT_CHRC_READ | BT_GATT_CHRC_WRITE,
        BT_GATT_PERM_READ | BT_GATT_PERM_WRITE, read_interval, write_interval, NULL),
    BT_GATT_CUD("Blink interval ms: uint16 little-endian, 50..5000", BT_GATT_PERM_READ),
    BT_GATT_CHARACTERISTIC(&state_uuid.uuid, BT_GATT_CHRC_READ,
        BT_GATT_PERM_READ, read_state, NULL, NULL),
    BT_GATT_CUD("State: mode, lit, interval low byte, interval high byte", BT_GATT_PERM_READ)
);
```

## src/led_service.h
```c
#ifndef NORA_LED_SERVICE_H
#define NORA_LED_SERVICE_H

#include <stdint.h>

enum led_mode { LED_OFF = 0, LED_ON = 1, LED_BLINK = 2 };
#define LED_INTERVAL_MIN_MS 50
#define LED_INTERVAL_MAX_MS 5000

struct led_state {
    uint8_t mode;
    uint8_t lit;
    uint16_t interval_ms;
};

int led_control_init(void);
int led_set_mode(uint8_t mode);
int led_set_interval(uint16_t interval_ms);
struct led_state led_snapshot(void);

#endif
```
