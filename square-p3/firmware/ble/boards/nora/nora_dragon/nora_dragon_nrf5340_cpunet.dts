/dts-v1/;
#include <nordic/nrf5340_cpunet_qkaa.dtsi>
#include <nordic/nrf5340_shared_sram_partition.dtsi>

/ {
    model = "NORA Dragon P3 BLE network controller";
    compatible = "nora,dragon-p3-net";
    chosen {
        zephyr,sram = &sram1;
        zephyr,flash = &flash1;
        zephyr,bt-hci-ipc = &ipc0;
    };
};
