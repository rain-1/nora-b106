## minimal-p1/firmware/boards/nora/nora_b106_minimal/Kconfig.nora_b106_minimal
```kconfig
# SPDX-License-Identifier: Apache-2.0
config BOARD_NORA_B106_MINIMAL
    select SOC_NRF5340_CPUAPP_QKAA
```

## minimal-p1/firmware/boards/nora/nora_b106_minimal/board.yml
```yaml
board:
  name: nora_b106_minimal
  full_name: NORA-B106 Minimal P1
  vendor: others
  socs:
    - name: nrf5340
```

## minimal-p2/firmware/boards/nora/nora_b106_minimal/board.yml
```yaml
board:
  name: nora_b106_minimal
  full_name: NORA-B106 Compact P2
  vendor: others
  socs:
    - name: nrf5340
```

## minimal-p2/firmware/boards/nora/nora_b106_minimal/nora_b106_minimal_nrf5340_cpuapp_defconfig
```kconfig
# SPDX-License-Identifier: Apache-2.0
CONFIG_ARM_MPU=y
CONFIG_ARM_TRUSTZONE_M=y
CONFIG_GPIO=y
CONFIG_CLOCK_CONTROL_NRF_K32SRC_RC=y
CONFIG_CLOCK_CONTROL_NRF_K32SRC_500PPM=y
CONFIG_SOC_NRF53_CPUNET_ENABLE=n
```

## square-p3/firmware/ble/boards/nora/nora_dragon/Kconfig.nora_dragon
```kconfig
config BOARD_NORA_DRAGON
    select SOC_NRF5340_CPUAPP_QKAA if BOARD_NORA_DRAGON_NRF5340_CPUAPP
    select SOC_NRF5340_CPUNET_QKAA if BOARD_NORA_DRAGON_NRF5340_CPUNET
```

## square-p3/firmware/ble/boards/nora/nora_dragon/board.yml
```yaml
board:
  name: nora_dragon
  full_name: NORA-B106 Dragon P3 BLE bring-up
  vendor: others
  socs:
    - name: nrf5340
```

## square-p3/firmware/ble/boards/nora/nora_dragon/nora_dragon_nrf5340_cpuapp_defconfig
```kconfig
CONFIG_ARM_MPU=y
CONFIG_ARM_TRUSTZONE_M=y
CONFIG_GPIO=y
CONFIG_SERIAL=y
CONFIG_CONSOLE=y
CONFIG_UART_CONSOLE=y
CONFIG_CLOCK_CONTROL_NRF_K32SRC_RC=y
CONFIG_CLOCK_CONTROL_NRF_K32SRC_500PPM=y
CONFIG_NRF_APPROTECT_USE_UICR=y
CONFIG_NRF_SECURE_APPROTECT_USE_UICR=y
```

## square-p3/firmware/ble/boards/nora/nora_dragon/nora_dragon_nrf5340_cpunet_defconfig
```kconfig
CONFIG_CLOCK_CONTROL_NRF_K32SRC_RC=y
CONFIG_CLOCK_CONTROL_NRF_K32SRC_500PPM=y
CONFIG_NRF_APPROTECT_USE_UICR=y
CONFIG_CONSOLE=n
CONFIG_SERIAL=n
```
